## CMakeLists.txt
```
cmake_minimum_required(VERSION 3.20.0)
find_package(Zephyr REQUIRED HINTS $ENV{ZEPHYR_BASE})
project(vega_bridge VERSION 1.0)
target_sources(app PRIVATE src/main.c)
```

## prj.conf
```kconfig
# ── Bluetooth Central + GATT Client ─────────────────────────────────────────
CONFIG_BT=y
CONFIG_BT_CENTRAL=y
CONFIG_BT_GATT_CLIENT=y
CONFIG_BT_SMP=n
CONFIG_BT_MAX_CONN=1

# MTU must match STM32 TARGET_MTU (247 bytes)
CONFIG_BT_L2CAP_TX_MTU=247
CONFIG_BT_BUF_ACL_RX_SIZE=251
CONFIG_BT_BUF_ACL_TX_SIZE=251

# Accept STM32-initiated PHY and connection parameter updates
CONFIG_BT_USER_PHY_UPDATE=y
CONFIG_BT_DATA_LEN_UPDATE=y

# Enable 2M PHY in the SoftDevice Controller (required for bt_conn_le_phy_update to work)
CONFIG_BT_CTLR_PHY_2M=y

# Large event length budget so SDC stays on-air for multiple packets per CI
CONFIG_BT_CTLR_SDC_MAX_CONN_EVENT_LEN_DEFAULT_OVERRIDE=y
CONFIG_BT_CTLR_SDC_MAX_CONN_EVENT_LEN_DEFAULT=4000000


# More GATT TX slots to allow multi-packet-per-CI pipeline
CONFIG_BT_ATT_TX_COUNT=10

# SDC RX buffers — keeps the LL from NACKing at the air interface during a burst.
CONFIG_BT_CTLR_SDC_RX_PACKET_COUNT=8

# HOST ACL RX pool — default is 1 + BT_MAX_CONN = 2.
# Host flow control reports this count to the SDC; SDC will NACK any PDU beyond
# this limit even if its own LL buffers are free.  Set to 8 to match SDC depth.
CONFIG_BT_BUF_ACL_RX_COUNT_EXTRA=7

# ── USB CDC ACM (old device stack — works on NCS 2.x and NCS 3.x compat) ────
# If this fails to compile on NCS 3.x, switch to:
#   CONFIG_USB_DEVICE_STACK_NEXT=y
#   CONFIG_USBD_CDC_ACM_CLASS=y
CONFIG_USB_DEVICE_STACK=y
CONFIG_USB_DEVICE_PRODUCT="Vega Bridge"
CONFIG_USB_DEVICE_MANUFACTURER="OpenIC"
CONFIG_USB_DEVICE_VID=0x1915
CONFIG_USB_DEVICE_PID=0x52BD
CONFIG_USB_CDC_ACM=y
CONFIG_UART_LINE_CTRL=y

# ── Console: goes to UART0 / J-Link VirtualCOM (not USB) ────────────────────
CONFIG_UART_CONSOLE=y
CONFIG_CONSOLE=y
CONFIG_SERIAL=y

# ── Logging ──────────────────────────────────────────────────────────────────
CONFIG_LOG=y
CONFIG_LOG_DEFAULT_LEVEL=3

# ── Kernel ───────────────────────────────────────────────────────────────────
CONFIG_MAIN_STACK_SIZE=4096
CONFIG_SYSTEM_WORKQUEUE_STACK_SIZE=2048
CONFIG_HEAP_MEM_POOL_SIZE=16384

# Message queue: 32 slots × 244 bytes = 7 808 bytes
# Defined in source via K_MSGQ_DEFINE
```

## boards/nrf52840dk_nrf52840.overlay
```dts
/*
 * DT overlay for nRF52840 DK:
 * - Keep console on UART0 (J-Link VirtualCOM, not USB)
 * - Add CDC ACM uart node to the USB device controller
 */

/ {
    chosen {
        zephyr,console   = &uart0;
        zephyr,shell-uart = &uart0;
    };
};

&usbd {
    cdc_acm_uart0: cdc_acm_uart0 {
        compatible = "zephyr,cdc-acm-uart";
    };
};
```

## src/main.c
```c
/*
 * vega_bridge — nRF52840 BLE Central → USB CDC bridge
 *
 * Connects to the Kuntur STM32WB09 as a BLE central ("Kuntur-N"),
 * subscribes to the 0xFFF2 notify characteristic, and forwards every
 * 244-byte StreamDataPacket_t to the PC via USB CDC ACM.
 *
 * Frame format over USB (for PC re-sync):
 *   [0xAA][0x55][len_lo][len_hi][payload...]
 *
 * USB TX uses an IRQ-driven ring buffer so the USB TX thread never
 * blocks when the PC application is not reading.
 *
 * LEDs (nRF52840 DK, active-low):
 *   LED0 — BLE connected
 *   LED1 — USB CDC open (DTR asserted by PC)
 *   LED2 — data flowing (toggles each packet)
 *   LED3 — overflow / error
 */

#include <zephyr/kernel.h>
#include <zephyr/sys/ring_buffer.h>
#include <zephyr/drivers/gpio.h>
#include <zephyr/drivers/uart.h>
#include <zephyr/usb/usb_device.h>
#include <zephyr/bluetooth/bluetooth.h>
#include <zephyr/bluetooth/gatt.h>
#include <zephyr/bluetooth/conn.h>
#include <zephyr/bluetooth/uuid.h>
#include <zephyr/bluetooth/hci.h>
#include <zephyr/logging/log.h>
#include <string.h>

LOG_MODULE_REGISTER(vega_bridge, LOG_LEVEL_INF);

/* ── Constants ─────────────────────────────────────────────────────────────── */

#define PACKET_SIZE      244U
#define FRAME_HDR_SIZE   4U
#define FRAME_SIZE       (FRAME_HDR_SIZE + PACKET_SIZE)
#define QUEUE_DEPTH      32U

/* USB TX ring buffer: holds 32 complete frames; headroom for 5-pkt/CI bursts */
#define USB_TX_RB_SIZE   (FRAME_SIZE * 32U)

static const char TARGET_NAME[] = "Kuntur-N";

static struct bt_uuid_16 stream_svc_uuid  = BT_UUID_INIT_16(0xFFF0);
static struct bt_uuid_16 notify_char_uuid = BT_UUID_INIT_16(0xFFF2);

/* ── LEDs ───────────────────────────────────────────────────────────────────── */

static const struct gpio_dt_spec led_ble  = GPIO_DT_SPEC_GET(DT_ALIAS(led0), gpios);
static const struct gpio_dt_spec led_usb  = GPIO_DT_SPEC_GET(DT_ALIAS(led1), gpios);
static const struct gpio_dt_spec led_data = GPIO_DT_SPEC_GET(DT_ALIAS(led2), gpios);
static const struct gpio_dt_spec led_err  = GPIO_DT_SPEC_GET(DT_ALIAS(led3), gpios);

static void leds_init(void)
{
    gpio_pin_configure_dt(&led_ble,  GPIO_OUTPUT_INACTIVE);
    gpio_pin_configure_dt(&led_usb,  GPIO_OUTPUT_INACTIVE);
    gpio_pin_configure_dt(&led_data, GPIO_OUTPUT_INACTIVE);
    gpio_pin_configure_dt(&led_err,  GPIO_OUTPUT_INACTIVE);
}

/* ── BLE→USB message queue ──────────────────────────────────────────────────── */

K_MSGQ_DEFINE(ble_msgq, PACKET_SIZE, QUEUE_DEPTH, 4);

/* ── Throughput + inter-packet dt histogram ─────────────────────────────────── */

static atomic_t s_pkt_rx = ATOMIC_INIT(0);

/* Inter-packet dt histogram (all consecutive pairs, ms granularity).
 * Buckets: 0=[0-1ms]  1=[1-2ms]  2=[2-3ms]  3=[3-5ms]  4=[5-10ms]  5=[10+ms]
 * At 2M PHY, same-CI packets arrive ~1.4ms apart (bucket 1).
 * CI-boundary gaps depend on pkt/CI:
 *   4 pkt/CI → ~3.3ms gap (bucket 3)
 *   1 pkt/CI → ~7.5ms gap (bucket 4)
 * Updated by notify_cb; read (unsynchronised) by usb_tx_fn.            */
static uint32_t s_dt_hist[6];
static const uint32_t s_dt_limits[6] = {1, 2, 3, 5, 10, UINT32_MAX};

/* ── USB CDC state ──────────────────────────────────────────────────────────── */

static const struct device *cdc_dev;
static bool                 usb_dtr;

/* IRQ-driven TX ring buffer — filled by usb_tx_fn, drained by CDC TX IRQ */
RING_BUF_DECLARE(usb_tx_rb, USB_TX_RB_SIZE);
static atomic_t usb_tx_irq_active = ATOMIC_INIT(0);

/* ── CDC IRQ handler ────────────────────────────────────────────────────────── */

static void cdc_irq_handler(const struct device *dev, void *user_data)
{
    ARG_UNUSED(user_data);

    while (uart_irq_update(dev) && uart_irq_is_pending(dev)) {

        /* TX: drain the ring buffer into the CDC FIFO */
        if (uart_irq_tx_ready(dev)) {
            uint8_t  *data;
            uint32_t  claim_len;

            claim_len = ring_buf_get_claim(&usb_tx_rb, &data, 64U);
            if (claim_len > 0) {
                int sent = uart_fifo_fill(dev, data, (int)claim_len);
                ring_buf_get_finish(&usb_tx_rb, (uint32_t)MAX(sent, 0));
            } else {
                /* Ring buffer empty — disable TX IRQ until more data arrives */
                uart_irq_tx_disable(dev);
                atomic_set(&usb_tx_irq_active, 0);
            }
        }

        /* RX: used only for DTR line control detection */
        if (uart_irq_rx_ready(dev)) {
            uint8_t dummy;
            uart_fifo_read(dev, &dummy, 1);
        }
    }
}

/* ── Non-blocking USB frame write ───────────────────────────────────────────── */

static void usb_write_frame(const uint8_t *payload, uint16_t payload_len)
{
    uint8_t frame[FRAME_SIZE];
    frame[0] = 0xAA;
    frame[1] = 0x55;
    frame[2] = (uint8_t)(payload_len & 0xFF);
    frame[3] = (uint8_t)((payload_len >> 8) & 0xFF);
    memcpy(&frame[4], payload, payload_len);

    uint32_t written = ring_buf_put(&usb_tx_rb, frame, FRAME_SIZE);
    if (written < FRAME_SIZE) {
        gpio_pin_set_dt(&led_err, 1);
        LOG_WRN("USB TX ring full — frame dropped");
    } else {
        gpio_pin_set_dt(&led_err, 0);
    }

    /* Kick the TX IRQ if not already running */
    if (atomic_cas(&usb_tx_irq_active, 0, 1)) {
        uart_irq_tx_enable(cdc_dev);
    }
}

/* ── DTR poll ───────────────────────────────────────────────────────────────── */

static void poll_dtr(void)
{
    uint32_t dtr = 0;
    uart_line_ctrl_get(cdc_dev, UART_LINE_CTRL_DTR, &dtr);
    bool new_dtr = (bool)dtr;
    if (new_dtr != usb_dtr) {
        usb_dtr = new_dtr;
        gpio_pin_set_dt(&led_usb, usb_dtr ? 1 : 0);
        LOG_INF("DTR %s", usb_dtr ? "set" : "cleared");
        if (!usb_dtr) {
            /* PC closed port — flush TX ring buffer to avoid stale data */
            ring_buf_reset(&usb_tx_rb);
        }
    }
}

/* ── Connection + GATT state ────────────────────────────────────────────────── */

static struct bt_conn                *current_conn;
static struct bt_gatt_discover_params disc_params;
static struct bt_gatt_subscribe_params sub_params;
static uint16_t                       notify_value_handle;

/* ── BLE notification callback ──────────────────────────────────────────────── */

static uint8_t notify_cb(struct bt_conn *conn,
                          struct bt_gatt_subscribe_params *params,
                          const void *data, uint16_t length)
{
    if (!data) {
        LOG_WRN("Unsubscribed from 0xFFF2");
        return BT_GATT_ITER_STOP;
    }

    if (length != PACKET_SIZE) {
        LOG_WRN("Unexpected packet size: %u", length);
        return BT_GATT_ITER_CONTINUE;
    }

    /* Inter-packet dt histogram. */
    static uint32_t s_last_pkt_ms;
    uint32_t now_ms = k_uptime_get_32();
    if (s_last_pkt_ms != 0) {
        uint32_t dt = now_ms - s_last_pkt_ms;
        for (int b = 0; b < 6; b++) {
            if (dt < s_dt_limits[b]) { s_dt_hist[b]++; break; }
        }
    }
    s_last_pkt_ms = now_ms;

    if (k_msgq_put(&ble_msgq, data, K_NO_WAIT) != 0) {
        gpio_pin_set_dt(&led_err, 1);
        LOG_WRN("BLE queue full — packet dropped");
    } else {
        gpio_pin_toggle_dt(&led_data);
        atomic_inc(&s_pkt_rx);
    }

    return BT_GATT_ITER_CONTINUE;
}

/* ── GATT discovery ─────────────────────────────────────────────────────────── */

static uint8_t descriptor_disc_cb(struct bt_conn *conn,
                                   const struct bt_gatt_attr *attr,
                                   struct bt_gatt_discover_params *params)
{
    if (!attr) {
        LOG_ERR("CCCD not found");
        return BT_GATT_ITER_STOP;
    }
    LOG_INF("CCCD handle: 0x%04x", attr->handle);
    sub_params.notify       = notify_cb;
    sub_params.value        = BT_GATT_CCC_NOTIFY;
    sub_params.value_handle = notify_value_handle;
    sub_params.ccc_handle   = attr->handle;
    int err = bt_gatt_subscribe(conn, &sub_params);
    if (err && err != -EALREADY) {
        LOG_ERR("Subscribe failed: %d", err);
    } else {
        LOG_INF("Subscribed to 0xFFF2 — streaming started");
    }
    return BT_GATT_ITER_STOP;
}

static uint8_t char_disc_cb(struct bt_conn *conn,
                              const struct bt_gatt_attr *attr,
                              struct bt_gatt_discover_params *params)
{
    if (!attr) {
        LOG_ERR("Characteristic 0xFFF2 not found");
        return BT_GATT_ITER_STOP;
    }
    const struct bt_gatt_chrc *chrc = (struct bt_gatt_chrc *)attr->user_data;
    notify_value_handle = chrc->value_handle;
    LOG_INF("0xFFF2 value handle: 0x%04x", notify_value_handle);

    static struct bt_uuid_16 cccd_uuid = BT_UUID_INIT_16(BT_UUID_GATT_CCC_VAL);
    disc_params.uuid         = &cccd_uuid.uuid;
    disc_params.type         = BT_GATT_DISCOVER_DESCRIPTOR;
    disc_params.start_handle = notify_value_handle + 1;
    disc_params.end_handle   = BT_ATT_LAST_ATTRIBUTE_HANDLE;
    disc_params.func         = descriptor_disc_cb;
    bt_gatt_discover(conn, &disc_params);
    return BT_GATT_ITER_STOP;
}

static uint8_t service_disc_cb(struct bt_conn *conn,
                                const struct bt_gatt_attr *attr,
                                struct bt_gatt_discover_params *params)
{
    if (!attr) {
        LOG_ERR("Service 0xFFF0 not found");
        return BT_GATT_ITER_STOP;
    }
    LOG_INF("Service 0xFFF0 handle: 0x%04x", attr->handle);
    const struct bt_gatt_service_val *svc = (struct bt_gatt_service_val *)attr->user_data;
    disc_params.uuid         = &notify_char_uuid.uuid;
    disc_params.type         = BT_GATT_DISCOVER_CHARACTERISTIC;
    disc_params.start_handle = attr->handle + 1;
    disc_params.end_handle   = svc->end_handle;
    disc_params.func         = char_disc_cb;
    bt_gatt_discover(conn, &disc_params);
    return BT_GATT_ITER_STOP;
}

static void start_discovery(struct bt_conn *conn)
{
    disc_params.uuid         = &stream_svc_uuid.uuid;
    disc_params.type         = BT_GATT_DISCOVER_PRIMARY;
    disc_params.start_handle = BT_ATT_FIRST_ATTRIBUTE_HANDLE;
    disc_params.end_handle   = BT_ATT_LAST_ATTRIBUTE_HANDLE;
    disc_params.func         = service_disc_cb;
    int err = bt_gatt_discover(conn, &disc_params);
    if (err) {
        LOG_ERR("Discovery start failed: %d", err);
    }
}

/* ── MTU exchange ───────────────────────────────────────────────────────────── */

static struct bt_gatt_exchange_params mtu_params;

static void mtu_exchange_cb(struct bt_conn *conn, uint8_t err,
                              struct bt_gatt_exchange_params *params)
{
    if (err) {
        LOG_WRN("MTU exchange failed: %d — starting discovery anyway", err);
    } else {
        LOG_INF("MTU exchanged: %u bytes", bt_gatt_get_mtu(conn));
    }
    start_discovery(conn);
}

/* ── Connection parameters ──────────────────────────────────────────────────── */

static const struct bt_le_conn_param fast_conn_params =
    BT_LE_CONN_PARAM_INIT(6, 6, 0, 500);   /* 7.5 ms CI, 5 s timeout */

/* ── Connection callbacks ───────────────────────────────────────────────────── */

static void le_param_updated_cb(struct bt_conn *conn, uint16_t interval,
                                  uint16_t latency, uint16_t timeout)
{
    uint32_t ci_ms_x100 = (uint32_t)interval * 125U;
    LOG_INF("CI updated: %u.%02u ms  latency=%d  timeout=%d ms",
            ci_ms_x100 / 100U, ci_ms_x100 % 100U, latency, timeout * 10);

    /* CI is now at 7.5 ms (interval=6) — safe to request 2M PHY.
     * Remote LE features are guaranteed exchanged by the time CI update completes. */
    if (interval <= 8) {
        static const struct bt_conn_le_phy_param phy_2m = {
            .options    = BT_CONN_LE_PHY_OPT_NONE,
            .pref_tx_phy = BT_GAP_LE_PHY_2M,
            .pref_rx_phy = BT_GAP_LE_PHY_2M,
        };
        int err = bt_conn_le_phy_update(conn, &phy_2m);
        if (err) {
            LOG_WRN("PHY 2M request failed: %d — staying on 1M", err);
        } else {
            LOG_INF("PHY update to 2M requested");
        }
    }
}

static void le_phy_updated_cb(struct bt_conn *conn,
                               struct bt_conn_le_phy_info *param)
{
    /* 1=1M, 2=2M, 3=Coded */
    LOG_INF("PHY updated: TX=%u RX=%u", param->tx_phy, param->rx_phy);
}

static void connected_cb(struct bt_conn *conn, uint8_t err)
{
    if (err) {
        LOG_ERR("Connection failed: %d", err);
        bt_conn_unref(conn);
        current_conn = NULL;
        return;
    }

    current_conn = bt_conn_ref(conn);

    struct bt_conn_info info;
    if (bt_conn_get_info(conn, &info) == 0 && info.le.interval > 0) {
        uint32_t ci_x100 = (uint32_t)info.le.interval * 125U;
        LOG_INF("Connected: initial CI=%u.%02u ms",
                ci_x100 / 100U, ci_x100 % 100U);
    } else {
        LOG_INF("Connected");
    }
    gpio_pin_set_dt(&led_ble, 1);

    /* Request 7.5 ms CI as central — STM32 CPUP is suppressed in NORDIC_HF.
     * 2M PHY is requested in le_param_updated_cb once CI is confirmed. */
    bt_conn_le_param_update(conn, &fast_conn_params);

    /* Exchange MTU before discovery */
    mtu_params.func = mtu_exchange_cb;
    int mtu_err = bt_gatt_exchange_mtu(conn, &mtu_params);
    if (mtu_err) {
        LOG_WRN("MTU request failed: %d", mtu_err);
        start_discovery(conn);
    }
}

static void disconnected_cb(struct bt_conn *conn, uint8_t reason)
{
    LOG_INF("Disconnected (reason 0x%02x)", reason);
    gpio_pin_set_dt(&led_ble,  0);
    gpio_pin_set_dt(&led_data, 0);
    bt_conn_unref(current_conn);
    current_conn = NULL;

    /* Drain stale BLE packets */
    uint8_t dummy[PACKET_SIZE];
    while (k_msgq_get(&ble_msgq, dummy, K_NO_WAIT) == 0) {}

    /* Restart scan */
    bt_le_scan_start(BT_LE_SCAN_ACTIVE, NULL);
}

BT_CONN_CB_DEFINE(conn_callbacks) = {
    .connected        = connected_cb,
    .disconnected     = disconnected_cb,
    .le_param_updated = le_param_updated_cb,
    .le_phy_updated   = le_phy_updated_cb,
};

/* ── Scan callback ──────────────────────────────────────────────────────────── */

static bool parse_ad_name(struct bt_data *data, void *user_data)
{
    bool *found = (bool *)user_data;
    if (data->type == BT_DATA_NAME_COMPLETE ||
        data->type == BT_DATA_NAME_SHORTENED) {
        size_t tlen = sizeof(TARGET_NAME) - 1;
        if (data->data_len == tlen &&
            memcmp(data->data, TARGET_NAME, tlen) == 0) {
            *found = true;
            return false;
        }
    }
    return true;
}

static void scan_cb(const bt_addr_le_t *addr, int8_t rssi,
                    uint8_t adv_type, struct net_buf_simple *buf)
{
    bool found = false;
    bt_data_parse(buf, parse_ad_name, &found);
    if (!found) return;

    LOG_INF("Found \"%s\" (RSSI %d) — connecting", TARGET_NAME, rssi);
    bt_le_scan_stop();

    struct bt_conn *conn;
    int err = bt_conn_le_create(addr, BT_CONN_LE_CREATE_CONN,
                                &fast_conn_params, &conn);
    if (err) {
        LOG_ERR("Connect failed: %d", err);
        bt_le_scan_start(BT_LE_SCAN_ACTIVE, NULL);
    } else {
        bt_conn_unref(conn);
    }
}

/* ── USB TX thread ──────────────────────────────────────────────────────────── */

#define USB_TX_STACK_SIZE  2048
K_THREAD_STACK_DEFINE(usb_tx_stack, USB_TX_STACK_SIZE);
static struct k_thread usb_tx_thread;

static void usb_tx_fn(void *p1, void *p2, void *p3)
{
    uint8_t pkt[PACKET_SIZE];
    int64_t last_log = k_uptime_get();

    while (true) {
        if (k_msgq_get(&ble_msgq, pkt, K_MSEC(200)) != 0) {
            poll_dtr();
        } else {
            poll_dtr();
            if (usb_dtr) {
                usb_write_frame(pkt, PACKET_SIZE);
            }
        }

        int64_t now = k_uptime_get();
        int64_t elapsed = now - last_log;
        if (elapsed >= 5000) {
            uint32_t n = (uint32_t)atomic_set(&s_pkt_rx, 0);
            uint32_t pkt_s  = (uint32_t)(n * 1000U / (uint32_t)elapsed);
            uint32_t sps    = pkt_s * 59U;
            LOG_INF("Throughput: %u pkt/s  %u SPS", pkt_s, sps);

            /* Inter-packet dt histogram: bucket[ms range] = count of consecutive pairs.
             * At 2M PHY: same-CI pairs ~1.4ms (bucket[1]); CI gaps vary with pkt/CI:
             *   4 pkt/CI → 3.3ms gap (bucket[3]);  1 pkt/CI → 7.5ms gap (bucket[4]) */
            LOG_INF("dt hist (ms): [0-1]=%u [1-2]=%u [2-3]=%u [3-5]=%u [5-10]=%u [10+]=%u",
                    s_dt_hist[0], s_dt_hist[1], s_dt_hist[2],
                    s_dt_hist[3], s_dt_hist[4], s_dt_hist[5]);
            last_log = now;
        }
    }
}

/* ── Main ───────────────────────────────────────────────────────────────────── */

int main(void)
{
    leds_init();
    LOG_INF("Vega Bridge starting");

    cdc_dev = DEVICE_DT_GET(DT_NODELABEL(cdc_acm_uart0));
    if (!device_is_ready(cdc_dev)) {
        LOG_ERR("CDC ACM not ready");
        return -ENODEV;
    }

    uart_line_ctrl_set(cdc_dev, UART_LINE_CTRL_DCD, 1);
    uart_line_ctrl_set(cdc_dev, UART_LINE_CTRL_DSR, 1);

    int err = usb_enable(NULL);
    if (err) {
        LOG_ERR("USB enable failed: %d", err);
        return err;
    }
    k_sleep(K_MSEC(1000));

    /* Register IRQ callback — handles both TX drain and RX (for DTR) */
    uart_irq_callback_user_data_set(cdc_dev, cdc_irq_handler, NULL);
    uart_irq_rx_enable(cdc_dev);

    k_thread_create(&usb_tx_thread, usb_tx_stack,
                    K_THREAD_STACK_SIZEOF(usb_tx_stack),
                    usb_tx_fn, NULL, NULL, NULL,
                    K_PRIO_PREEMPT(7), 0, K_NO_WAIT);
    k_thread_name_set(&usb_tx_thread, "usb_tx");

    err = bt_enable(NULL);
    if (err) {
        LOG_ERR("Bluetooth init failed: %d", err);
        return err;
    }
    LOG_INF("Bluetooth ready — scanning for \"%s\"", TARGET_NAME);

    err = bt_le_scan_start(BT_LE_SCAN_ACTIVE, scan_cb);
    if (err) {
        LOG_ERR("Scan start failed: %d", err);
        return err;
    }

    return 0;
}
```
